## layers/meta-demo-ci/conf/layer.conf
```bitbake
LAYERNAME = "meta-demo-ci"
LAYERDEPENDS = "oe-core"
LAYERSERIES_COMPAT = "garburn"

addpylib ${LAYERDIR}/lib oeaws.botos3fetcher
```

## layers/meta-tegra-support/conf/layer.conf
```bitbake
LAYERNAME = "meta-tegra-support"
LAYERDEPENDS = "oe-core meta-tegra"
LAYERSERIES_COMPAT = "garburn"
```

## layers/meta-tegrademo/conf/layer.conf
```bitbake
LAYERNAME = "tegrademo"
LAYERSERIES_COMPAT = "garburn"
LAYERDEPENDS = "oe-core meta-tegra meta-oe meta-oe-python meta-oe-networking meta-oe-filesystems meta-virtualization meta-tegra-community meta-tegra-support meta-demo-ci"
LAYER_FRAGMENTS_OPTED_OUT = "meta-virtualization/virt meta-virtualization/xen meta-virtualization/container meta-virtualization/k8s"
```
